/*
 * Copyright (c) 2020 Pete Johanson
 *
 * SPDX-License-Identifier: MIT
 */

/* Habilita o display principal do ZMK */
/ {
	chosen {
		zmk,display = &oled;
	};
};

/* Habilita o barramento I2C */
&i2c0 {
	status = "okay";

	/* Define o display OLED no barramento I2C */
	oled: ssd1306@3c {
		compatible = "solomon,ssd1306fb";
		reg = <0x3c>;
		label = "DISPLAY";
		width = <128>;
		height = <32>;
		segment-offset = <0>;
	};
};